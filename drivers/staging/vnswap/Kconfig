## drivers/staging/vnswap/Kconfig
```kconfig
config VNSWAP
	tristate "Fake device for swap"
	depends on BLOCK && SYSFS && ZSWAP
	default n
```

## fs/exfat/Kconfig
```kconfig
menu "exFAT Filesystem"

config EXFAT_FS
	tristate "exFAT fs support"
	select NLS
	help
	  This adds support for the exFAT file system.

config EXFAT_DISCARD
	bool "enable discard support"
	depends on EXFAT_FS
	default y

config EXFAT_DELAYED_SYNC
	bool "enable delayed sync"
	depends on EXFAT_FS
	default n

config EXFAT_KERNEL_DEBUG
	bool "enable kernel debug features via ioctl"
	depends on EXFAT_FS
	default n

config EXFAT_DEBUG_MSG
	bool "print debug messages"
	depends on EXFAT_FS
	default n

config EXFAT_DEFAULT_CODEPAGE
	int "Default codepage for exFAT"
	default 437
	depends on EXFAT_FS
	help
	  This option should be set to the codepage of your exFAT filesystems.

config EXFAT_DEFAULT_IOCHARSET
	string "Default iocharset for exFAT"
	default "utf8"
	depends on EXFAT_FS
	help
	  Set this to the default input/output character set you'd like exFAT to use.

config EXFAT_VIRTUAL_XATTR
	bool "Virtual xattr support for exFAT filesystem"
	default y
	depends on EXFAT_FS
	help
	  Modification of exFAT filesystem for virtual xattr

config EXFAT_VIRTUAL_XATTR_SELINUX_LABEL
	string "Default string for SELinux label"
	depends on EXFAT_FS && EXFAT_VIRTUAL_XATTR
	default "u:object_r:sdcard_external:s0"
	help
	  Set this to the default string for SELinux label.

config EXFAT_SUPPORT_STLOG
	bool "Enable storage log"
	default y
	depends on EXFAT_FS && PROC_STLOG

endmenu
```

## fs/sdcardfs_mm/Kconfig
```kconfig
config SDCARD_FS_MM
	tristate "sdcard file system MM"
	depends on CONFIGFS_FS
	default n
	help
	  Sdcardfs is based on Wrapfs file system.
```

## techpack/datarmnet-ext/offload/Kconfig
```kconfig
#
# RMNET_OFFLOAD driver
#

menuconfig RMNET_OFFLOAD
    tristate "Rmnet offload support"
    default y
    depends on RMNET_CORE
    ---help---
        Offload support for the RmNet driver
```

## techpack/datarmnet-ext/shs/Kconfig
```kconfig
#
# RMNET_SHS driver
#

menuconfig RMNET_SHS
    tristate "Rmnet SHS driver"
    default y
    depends on RMNET_CORE
    ---help---
        performance mode of rmnet driver
```
