/dts-v1/;

#include "katmai.dtsi"
#include "yupik-iot-hsp-pm7250b.dtsi"

/ {
	model = "Qualcomm Technologies, Inc. Katmai HSP + PM7250B";
	compatible = "qcom,yupik-iot-idp", "qcom,yupik-iot", "qcom,idp";
	qcom,board-id = <34 1>;
};
