/dts-v1/;
/plugin/;

#include "yupik-iot-hsp-pm7250b.dtsi"

/ {
	model = "Qualcomm Technologies, Inc. Yupik IOT HSP + PM7250B";
	compatible = "qcom,yupik-iot-idp", "qcom,yupik-iot", "qcom,idp";
	qcom,msm-id = <497 0x10000>;
	qcom,board-id = <34 1>;
};
