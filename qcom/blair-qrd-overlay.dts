/dts-v1/;

#include "blair.dtsi"
#include "blair-qrd.dtsi"

/ {
	model = "Qualcomm Technologies, Inc. Blair QRD";
	compatible = "qcom,blair-qrd", "qcom,blair", "qcom,qrd";
	qcom,msm-id = <507 0x10000>;
	qcom,board-id = <0x1000B 0>;
};

