/dts-v1/;
/plugin/;

#include "yupik-iot-hsp.dtsi"

/ {
	model = "Qualcomm Technologies, Inc. Yupik IoT HSP";
	compatible = "qcom,yupik-iot-idp", "qcom,yupik-iot", "qcom,idp";
	qcom,msm-id = <497 0x10000>;
	qcom,board-id = <34 1>;
};
