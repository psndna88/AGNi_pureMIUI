&soc {
	timer {
		clock-frequency = <5000000>;
	};

	timer@f120000 {
		clock-frequency = <5000000>;
	};

	wdog: qcom,wdt@f017000 {
		status = "disabled";
	};

};

#include "monaco-stub-regulator.dtsi"
