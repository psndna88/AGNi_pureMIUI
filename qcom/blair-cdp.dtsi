#include "holi-cdp-pm6125.dtsi"
#include "display/blair-sde-display-cdp.dtsi"
/ {
};

&ufsphy_mem {
	compatible = "qcom,ufs-phy-qmp-v4-yupik";
	vdda-phy-max-microamp = <85700>;
};

&pm6125_pwm {
	status = "ok";
};

&qupv3_se8_i2c {
	#address-cells = <1>;
	#size-cells = <0>;

	status = "ok";

	novatek@62 {
		compatible = "novatek,NVT-ts";
		reg = <0x62>;

		interrupt-parent = <&tlmm>;
		interrupts = <22 0x2008>;

		pinctrl-names = "pmx_ts_active","pmx_ts_suspend",
				"pmx_ts_release";

		pinctrl-0 = <&ts_active>;
		pinctrl-1 = <&ts_int_suspend &ts_reset_suspend>;
		pinctrl-2 = <&pmx_ts_release>;

		novatek,reset-gpio = <&tlmm 21 0x00>;
		novatek,irq-gpio = <&tlmm 22 0x2008>;

		panel = <&dsi_nt36672e_fhd_plus_60_video
			&dsi_nt36672e_fhd_plus_120_video
			&dsi_nt36672e_fhd_plus_144_video>;
	};
};
