/dts-v1/;

#include "blair.dtsi"
#include "blair-qrd.dtsi"

/ {
	model = "Qualcomm Technologies, Inc. Blair QRD";
	compatible = "qcom,blair-qrd", "qcom,blair", "qcom,qrd";
	qcom,board-id = <0x1000B 0>;
};

