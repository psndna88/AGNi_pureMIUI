/dts-v1/;

#include "katmaip.dtsi"
#include "yupikp-iot-hsp-pm7250b.dtsi"

/ {
	model = "Qualcomm Technologies, Inc. KatmaiP HSP + PM7250B";
	compatible = "qcom,yupikp-iot-idp", "qcom,yupikp-iot", "qcom,idp";
	qcom,board-id = <34 1>;
};
