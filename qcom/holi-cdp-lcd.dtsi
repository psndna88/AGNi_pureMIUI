#include "holi-cdp.dtsi"

&pm6150a_amoled {
	status = "disabled";
};

&pm6150l_lcdb {
	status = "ok";
};

&pm6150l_wled {
	status = "ok";
	qcom,string-cfg = <15>;
	qcom,leds-per-string = <4>;
};

&sde_dsi {
	lab-supply = <&lcdb_ldo_vreg>;
	ibb-supply = <&lcdb_ncp_vreg>;
	qcom,dsi-default-panel = <&dsi_sharp_qsync_fhd_video>;
};
