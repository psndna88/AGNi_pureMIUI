/dts-v1/;
/plugin/;

#include "yupik-idp-pm7250b.dtsi"

/ {
	model = "Qualcomm Technologies, Inc. Yupik IDP + PM7250B";
	compatible = "qcom,yupik-idp", "qcom,yupik", "qcom,idp";
	qcom,msm-id = <475 0x10000>, <515 0x10000>;
	/* Adding dummy Board subtype ID to bypass pmic protocol version check. */
	qcom,board-id = <34 0xFF>;
};
