/dts-v1/;

#include "sdxlemur.dtsi"
#include "sdxlemur-rcm-rc.dtsi"

/ {
	model = "Qualcomm Technologies, Inc. SDXLEMUR RCM Root Complex";
	compatible = "qcom,sdxlemur-rcm",
		"qcom,sdxlemur", "qcom,rcm";
	qcom,board-id = <0x1010015 0>;
};
