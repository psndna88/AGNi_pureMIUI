/dts-v1/;

#include "sdxlemur.dtsi"
#include "sdxlemur-mtp-mbb.dtsi"

/ {
	model = "Qualcomm Technologies, Inc. SDXLEMUR MTP MBB";
	compatible = "qcom,sdxlemur-mtp",
		"qcom,sdxlemur", "qcom,mtp";
	qcom,board-id = <0x2010008 0>;
};
