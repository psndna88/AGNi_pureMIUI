/dts-v1/;

#include "yupikp-iot.dtsi"
#include "yupikp-iot-idp-pm7250b.dtsi"

/ {
	model = "Qualcomm Technologies, Inc. YupikP IOT IDP + PM7250B";
	compatible = "qcom,yupikp-iot-idp", "qcom,yupikp-iot", "qcom,idp";
	qcom,board-id = <34 0>;
};
