/dts-v1/;

#include "sa8155-v2.dtsi"
#include "sa8155-adp-common.dtsi"
#include "display/sa8155-adp-star-display.dtsi"
#include "display/sa8155-adp-star-display-shd.dtsi"

/ {
	model = "Qualcomm Technologies, Inc. SA8155 V2 ADP AIR";
	compatible = "qcom,sa8155-v2-adp-air", "qcom,sa8155", "qcom,adp-air";
	qcom,board-id = <0x01000019 0>;
};
