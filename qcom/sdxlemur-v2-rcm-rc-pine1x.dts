/dts-v1/;

#include "sdxlemur-v2.dtsi"
#include "sdxlemur-rcm-rc.dtsi"
#include "sdxlemur-rcm-rc-pine1x.dtsi"
#include "sdxlemur-1024mb.dtsi"

/ {
	model = "Qualcomm Technologies, Inc. SDXLEMUR RCM Root Complex 1x Pine V2";
	compatible = "qcom,sdxlemur-rcm",
		"qcom,sdxlemur", "qcom,rcm";
	qcom,board-id = <0x2010015 0x302>;
};
