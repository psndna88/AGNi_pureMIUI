
&soc {
	slpi_tlmm: slpi_pinctrl@62B40000 {
		compatible = "qcom,slpi-pinctrl";
		reg = <0x62B40000 0x20000>;
		qcom,num-pins = <32>;
		clock-names = "ssc-clk";
		clocks =  <&scc SCC_QUPV3_S_HCLK_CLK>;
		status = "disabled";
	};
};
