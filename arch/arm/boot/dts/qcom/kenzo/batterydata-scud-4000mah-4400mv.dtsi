
qcom,longcheer_ct865scud_4000mah_battery {
	qcom,max-voltage-uv = <4400000>;
	qcom,nom-batt-capacity-mah = <4000>;
	qcom,batt-id-kohm = <100>;
	qcom,battery-beta = <4150>;
	qcom,battery-type = "longcheer_ct865scud_4000mah_battery";
	qcom,chg-rslow-comp-c1 = <2635539>;
	qcom,chg-rslow-comp-c2 = <2592188>;
	qcom,chg-rs-to-rslow = <1432403>;
	qcom,chg-rslow-comp-thr = <0x99>;
	qcom,checksum = <0x6EE9>;
	qcom,gui-version = "PMI8950GUI - 2.0.0.15";
	qcom,fg-profile-data = [
		EA 83 46 7D
		93 81 36 7C
		5B 83 D7 67
		FD 82 39 8D
		1F 82 FF 98
		B3 B6 01 C2
		64 18 FE 83
		AF 7D EA 81
		94 7C 82 83
		59 7D EF 90
		07 9C 37 82
		06 99 13 B7
		A4 C2 52 16
		1F 10 BE 58
		14 70 EE FC
		6E 3C E9 45
		43 40 00 00
		33 47 AF 33
		CE 34 00 00
		00 00 00 00
		00 00 00 00
		17 72 76 70
		7A 69 06 83
		D4 75 BA 68
		A5 5A 63 79
		50 6F 89 5A
		41 67 92 A2
		21 2F 68 50
		65 A0 71 0C
		28 00 FF 36
		F0 11 30 03
		00 00 00 0C
	];
};
