## arch/arm64/hotplug/Kconfig
```kconfig
config THUNDERPLUG_CONTROL
	tristate "ThunderPlug: hotplug of cores using powersuspend"
	help
	  This driver uses powersuspend to take down the cpu cores
	  ranging from dual core CPUs to Octa Core CPUs
```

## drivers/block/vbswap/Kconfig
```kconfig
config VBSWAP
	tristate "Fake block device for swap based on vnswap"
	depends on BLOCK && ZSWAP && !ZRAM
	default n
```

## drivers/char/srandom/Kconfig
```kconfig
config SRANDOM
	tristate "Seed Random Number Generator by josenk"
	default n

	---help---
	  This driver provides kernel-side support for
	  Seed Random Number Generator.

	  To compile this driver as a module, choose M here: the
	  module will be called srandom.

	  If unsure, say Y.
```

## drivers/cpufreq_bouncing/Kconfig
```kconfig
config OPLUS_FEATURE_CPUFREQ_BOUNCING
	tristate "cpufreq_bouncing"
	default n
	help
	  adjust cpu max frequency based on cpu busy duration
```

## drivers/dts_eagle/Kconfig
```kconfig
config AINUR_DTS_SW
	bool "Ainur DTS software driver"
	depends on ARM || ARM64
	default n
	help
	  Driver port of DTS' android audio software-processed
	  effect, which can be built side-by-side along with
	  the hardware-processed effect driver.
```

## drivers/input/fingerprint/fpc1020_hydrogen/Kconfig
```kconfig
config FINGERPRINT_FPC1020_HYDROGEN
	tristate "Finger print card FPC"
	depends on INPUT_FINGERPRINT
	---help---
	  Say Y here to enable support for FPC1020 fingerprint sensor.
	  If unsure, say N.

	  To compile this driver as a module, choose M here.
```

## drivers/input/fingerprint/fpc1020_kenzo/Kconfig
```kconfig
config FINGERPRINT_FPC1020_KENZO
	tristate "Finger print card FPC"
	depends on INPUT_FINGERPRINT
	---help---
	  Say Y here to enable support for FPC1020 fingerprint sensor.
	  If unsure, say N.

	  To compile this driver as a module, choose M here.
```

## drivers/input/fingerprint/fpc_tee/Kconfig
```kconfig
# SPDX-License-Identifier: GPL-2.0-only

config FINGERPRINT_FPC_TEE
	tristate "FPC1020 fingerprint sensor IRQ support"
	depends on INPUT_FINGERPRINT
	default y
	help
		If you say yes here you get IRQ support for the FPC1020 family
		of fingerprint sensors from Fingerprint Cards (FPC).
```

## drivers/input/fingerprint/goodix/Kconfig
```kconfig
config FINGERPRINT_GOODIX_GF318M
	tristate "Goodix GFX18M fingerprint driver support"
	depends on INPUT_FINGERPRINT
	---help---
	  Say Y here to enable support for goodix fingerprint sensor.
	  If unsure, say N.
```

## drivers/input/touchscreen/focal_ft8719/Kconfig
```kconfig
#
# Focaltech Touchscreen driver configuration
#

config TOUCHSCREEN_FOCAL_FT8719
        bool "Focaltech 8719 Touchscreen"
		depends on I2C
		default n
		help
		  Say Y here if you have Focaltech touch panel.
		  If unsure, say N.

config TOUCHSCREEN_FOCAL_FT8719_DIRECTORY
    string "Focaltech ts directory name"
    default "focaltech_touch"
    depends on TOUCHSCREEN_FOCAL_FT8719
    
```

## drivers/input/touchscreen/focaltech_touch/Kconfig
```kconfig
#
# Focaltech Touchscreen driver configuration
#

config TOUCHSCREEN_FTS_TOUCH
	tristate "Focaltech Touchscreen"
	default n
	help
	  Say Y here if you have Focaltech touch panel.
	  If unsure, say N.

config TOUCHSCREEN_FTS_DIRECTORY
	string "Focaltech ts directory name"
	default "focaltech_touch"
	depends on TOUCHSCREEN_FTS_TOUCH

config FTS_TRUSTED_TOUCH
	bool "Focaltech Trusted Touch"
	depends on TOUCHSCREEN_FTS_TOUCH
	help
	  Say Y here to enable Focaltech Trusted Touch.
	  If unsure, say N.

#endif
```

## drivers/input/touchscreen/nvt_touch_a/Kconfig
```kconfig
#
# Novatek NT36xxx touchscreen driver configuration
#
config TOUCHSCREEN_NVT_A
       tristate "novatek touchscreens NVT_A"
       help
         Say Y here if you have a nvt touchscreen.
		 nvt controllers are multi touch controllers which can
		 report 5 touches at a time.
         If unsure, say N.
         To compile this driver as a module, choose M here: the
         module will be called nvt.
```

## drivers/input/touchscreen/nvt_touch_d2s/Kconfig
```kconfig
#
# Novatek NT36xxx touchscreen driver configuration
#
config TOUCHSCREEN_NVT_D2S
       tristate "novatek touchscreens NVT_D2S"
       help
         Say Y here if you have a nvt touchscreen.
		 nvt controllers are multi touch controllers which can
		 report 5 touches at a time.
         If unsure, say N.
         To compile this driver as a module, choose M here: the
         module will be called nvt.
```

## drivers/misc/mi-ioturbo/Kconfig
```kconfig
# SPDX-License-Identifier: GPL-2.0-only
#
# Mi ioturbo info
#


config MI_IOTURBO_SUPPORT
	tristate "xiaomi ioturbo function"
	default y
	help
	  This adds supprot for mi ioturbo function.
```

## drivers/net/ethernet/qualcomm/emac-dwc-eqos/Kconfig
```kconfig
#
# Synopsis EMAC device configuration
#

config EMAC_DWC_EQOS
	tristate "Qualcomm Technologies Inc. EMAC support"
	depends on (ARM || ARM64)
	default y
	help
	  This driver supports the Synopsis EMAC Gigabit
	  Ethernet controller.

config EMAC_APP
       bool "EMAC app support"
       depends on EMAC_DWC_EQOS
       default y
       help
         Say y here if you want to run Neutrino ethernet open function
```

## drivers/net/ethernet/qualcomm/rmnet/Kconfig
```kconfig
#
# RMNET MAP driver
#

menuconfig RMNET
	tristate "RmNet MAP driver"
	default y
	select GRO_CELLS
	---help---
	  If you select this, you will enable the RMNET module which is used
	  for handling data in the multiplexing and aggregation protocol (MAP)
	  format in the embedded data path. RMNET devices can be attached to
	  any IP mode physical device.

#
# RMNET_PERF driver
#

menuconfig RMNET_PERF
    tristate "Rmnet Perf driver"
    default y
    depends on RMNET
    ---help---
        performance mode of rmnet driver

#
# RMNET_SHS driver
#

menuconfig RMNET_SHS
    tristate "Rmnet SHS driver"
    default y
    depends on RMNET
    ---help---
        performance mode of rmnet driver
```

## drivers/net/wireless/realtek/rtl88x2bu/Kconfig
```kconfig
config RTL8822BU
	tristate "Realtek 8822B USB WiFi"
	depends on USB
	select WIRELESS_EXT
	default y
	help
	  Help message of RTL8822BU
```

## drivers/platform/xiaomi/Kconfig
```kconfig
# Xiaomi configuration options

config MACH_XIAOMI
	bool "XIAOMI device"
	depends on ARCH_MSM
	help
	  Support for Xiaomi products

config MACH_XIAOMI_MSM8956
	bool "XIAOMI MSM8956"
	depends on ARCH_MSM8916
	select MACH_XIAOMI
	help
	  Support for MSM8956 Xiaomi variants

config MACH_XIAOMI_KENZO_AGNI_MIUI
	bool

menu "Xiaomi board selection"

	config MACH_XIAOMI_KENZO
		bool "XIAOMI_KENZO board"
		select MACH_XIAOMI_MSM8956
		help
		  Support for Xiaomi Redmi Note 3 variant

	config MACH_XIAOMI_HYDROGEN
		bool "XIAOMI_HYDROGEN board"
		select MACH_XIAOMI_MSM8956
		help
		  Support for Xiaomi Mi Max variant

endmenu

choice
	prompt "AGNi variant selection"
	depends on MACH_XIAOMI_KENZO

	config MACH_XIAOMI_KENZO_AGNI_LOS_O
		bool "XIAOMI KENZO AGNi for LineageOS-Oreo"
		select MACH_XIAOMI_MSM8956
		help
		  Support for Xiaomi Redmi Note 3 AGNi LineageOS 15.x

	config MACH_XIAOMI_KENZO_AGNI_LOS_N
		bool "XIAOMI KENZO AGNi for LineageOS-Nougat"
		select MACH_XIAOMI_MSM8956
		help
		  Support for Xiaomi Redmi Note 3 AGNi LineageOS 14.x

	config MACH_XIAOMI_KENZO_AGNI_LOS_MM
		bool "XIAOMI KENZO AGNi for LineageOS-MarshMallow"
		select MACH_XIAOMI_MSM8956
		help
		  Support for Xiaomi Redmi Note 3 AGNi LineageOS 13.1

	config MACH_XIAOMI_KENZO_AGNI_MIUI_MM
		bool "XIAOMI KENZO AGNi for miui-MM"
		select MACH_XIAOMI_MSM8956
		select MACH_XIAOMI_KENZO_AGNI_MIUI
		help
		  Support for Xiaomi Redmi Note 3 AGNi MIUI MM

	config MACH_XIAOMI_KENZO_AGNI_MIUI_N
		bool "XIAOMI KENZO AGNi for miui-N"
		select MACH_XIAOMI_MSM8956
		select MACH_XIAOMI_KENZO_AGNI_MIUI
		help
		  Support for Xiaomi Redmi Note 3 AGNi MIUI N

endchoice
```

## drivers/power/supply/maxim/Kconfig
```kconfig
config BATT_VERIFY_BY_DS28E16
	bool "Support ds28e16 as encryption IC."
	default y
	help
		It needs a onewire physical controller to work.

config ONEWIRE_GPIO
	bool "Support Onewire Driver."
	depends on BATT_VERIFY_BY_DS28E16
	default y
	help
		It's an onewire driver.
```

## drivers/rmnet/perf/Kconfig
```kconfig
#
# RMNET_PERF driver
#

config RMNET_PERF
    tristate "Rmnet Perf driver"
    default y
#    depends on RMNET
    ---help---
        performance mode of rmnet driver
```

## drivers/rmnet/shs/Kconfig
```kconfig
#
# RMNET_SHS driver
#

config RMNET_SHS
    tristate "Rmnet SHS driver"
    default y
#    depends on RMNET
    ---help---
        performance mode of rmnet driver
```

## drivers/staging/frandom/Kconfig
```kconfig
config FRANDOM
	tristate "Frandom RNG driver"
	help
	  Frandom is a Linux kernel random number generator, which
	  is 10-50 times faster than what you get from Linux' built-in
	  /dev/urandom. And it uses very little (/dev/frandom) or none
	  (/dev/erandom) of the kernel's entropy pool, so it is very
	  useful for applications that require a handy source for lots
	  of random data.

	  http://www.billauer.co.il/frandom.html

	  If unsure here, select N.
	
```

## drivers/staging/rtl8192eu/Kconfig
```kconfig
config RTL8192EU
	tristate "Realtek RTL8192EU USB WiFi"
	depends on USB
	---help---
	  Help message of RTL8192EU
```

## drivers/staging/rtmm/Kconfig
```kconfig
config RTMM
	bool "enable runtime mem optimization"
	select SYSFS
	default y
	help
	  Thie module is created by MIUI to optimize mem performance.
```
