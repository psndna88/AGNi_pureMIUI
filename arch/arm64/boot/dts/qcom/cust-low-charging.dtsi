&pm6150_charger {
	qcom,fv-max-uv = <4480000>;
	qcom,fcc-max-ua = <3000000>;

	qcom,thermal-mitigation
	                        = <3000000 2900000 2800000 2600000 2400000 2200000 2000000 1800000 1500000 1000000>;
	qcom,thermal-mitigation-cp
	                        = <3000000 3000000 3000000 3000000 3000000 3000000 2500000 1800000 1200000 1000000>;
	qcom,thermal-mitigation-icl 
	                        = <2900000 2800000 2700000 2600000 2400000 2200000 2000000 1800000 1500000 1000000>;
	qcom,thermal-mitigation-dcp
	                        = <2100000 1800000 1800000 1800000 1700000 1600000 1400000 1200000 1100000 1000000>;
	qcom,thermal-mitigation-qc2
	                        = <1500000 1500000 1500000 1500000 1450000 1400000 1350000 1100000 1000000  900000>;
	qcom,thermal-fcc-qc3-normal
	                        = <3000000 2900000 2800000 2600000 2400000 2200000 2000000 1800000 1500000 1000000>;
	qcom,thermal-fcc-qc3-cp
	                        = <2800000 2600000 2600000 2600000 2400000 2200000 2000000 1800000 1500000 1000000>;
	qcom,thermal-fcc-qc3p5-cp
	                        = <3000000 2900000 2800000 2700000 2400000 2200000 2000000 1800000 1500000 1000000>;
	qcom,thermal-mitigation-pd-base
	                        = <2800000 2700000 2600000 2600000 2400000 2200000 2000000 1800000 1500000 1000000>;
	qcom,thermal-fcc-pps-cp
	                        = <3000000 2900000 2800000 2600000 2400000 2200000 2000000 1800000 1500000 1000000>;

	mi,support-ffc;
};

&smb1396_div2_cp_master {
	mi,qc3p5-ffc-batt;
};

&pm6150_pdphy {
	mi,pd_curr_limit = <1>;
	mi,pd_max_curr_limit = <4000000>;
	mi,limit_pd_vbus = <1>;
	mi,pd_vbus_max_limit = <9500000>;
};
