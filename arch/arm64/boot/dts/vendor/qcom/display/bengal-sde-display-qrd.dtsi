#include "bengal-sde-display.dtsi"

&dsi_ili9881c_720p_video {
	qcom,panel-supply-entries = <&dsi_panel_pwr_supply_no_labibb>;
	qcom,mdss-dsi-bl-pmic-control-type = "bl_ctrl_pwm";
	pwms = <&pm6125_pwm 0 0>;
	qcom,bl-pmic-pwm-period-usecs = <100>;
	qcom,mdss-dsi-bl-min-level = <1>;
	qcom,mdss-dsi-bl-max-level = <4095>;
	qcom,platform-te-gpio = <&tlmm 40 0>;
	qcom,platform-reset-gpio = <&ioexp21 2 0>;
	qcom,platform-reset-gpio-always-on;
	qcom,platform-bklight-en-gpio = <&ioexp21 3 0>;
	qcom,platform-en-gpio = <&ioexp22 6 0>;
};

&sde_dsi {
	qcom,dsi-default-panel = <&dsi_ili9881c_720p_video>;
};
