/dts-v1/;
/plugin/;

#include "blairp-cdp.dtsi"

/ {
	model = "Qualcomm Technologies, Inc. Blairp CDP";
	compatible = "qcom,blairp-cdp", "qcom,blairp", "qcom,cdp";
	qcom,msm-id = <565 0x10000>;
	qcom,board-id = <1 0>;
};

&wsa881x_analog_reset_gpio {
	pinctrl-0 = <&spkr_1_sd_n_active>;
	pinctrl-1 = <&spkr_1_sd_n_sleep>;
};
