/dts-v1/;

#include "sdxlemur.dtsi"
#include "sdxlemur-mtp-cpe.dtsi"
#include "sdxlemur-mtp-cpe-pine1x.dtsi"
#include "sdxlemur-1024mb.dtsi"
#include "sdxlemur-bluetooth.dtsi"

/ {
	model = "Qualcomm Technologies, Inc. SDXLEMUR MTP CPE 1x Pine";
	compatible = "qcom,sdxlemur-mtp",
		"qcom,sdxlemur", "qcom,mtp";
	qcom,board-id = <0x9010008 0x309>;
};

&ipa_hw {
	qcom,scaling-exceptions = "wdi", "1400", "4800", "10000";
};
