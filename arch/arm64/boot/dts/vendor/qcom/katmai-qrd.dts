/dts-v1/;

#include "katmai.dtsi"
#include "yupik-iot-qrd.dtsi"

/ {
	model = "Qualcomm Technologies, Inc. KATMAI QRD";
	compatible = "qcom,yupik-iot-qrd", "qcom,yupik-iot", "qcom,qrd";
	qcom,board-id = <0x1000B 0>;
};
