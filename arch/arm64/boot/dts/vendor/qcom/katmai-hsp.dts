/dts-v1/;

#include "katmai.dtsi"
#include "yupik-iot-hsp.dtsi"

/ {
	model = "Qualcomm Technologies, Inc. Katmai HSP";
	compatible = "qcom,yupik-iot-idp", "qcom,yupik-iot", "qcom,idp";
	qcom,board-id = <34 1>;
};
