/dts-v1/;

#include "blairp.dtsi"
#include "blairp-atp.dtsi"

/ {
	model = "Qualcomm Technologies, Inc. Blairp ATP";
	compatible = "qcom,blairp-atp", "qcom,blairp", "qcom,atp";
	qcom,board-id = <33 0>;
};
