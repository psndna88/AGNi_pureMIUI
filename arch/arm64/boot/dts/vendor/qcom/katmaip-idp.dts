/dts-v1/;

#include "katmaip.dtsi"
#include "yupikp-idp.dtsi"

/ {
	model = "Qualcomm Technologies, Inc. KATMAIP IDP";
	compatible = "qcom,yupikp-iot-idp", "qcom,yupikp-iot", "qcom,idp";
	qcom,board-id = <34 0>;
};
