/dts-v1/;

#include "sdxlemur-v2.dtsi"
#include "sdxlemur-mtp-mbb-pcie-ep-ipq.dtsi"
#include "sdxlemur-mtp-mbb-m2-ep.dtsi"
#include "sdxlemur-1024mb.dtsi"
#include "sdxlemur-v2-m2-ep-fwa.dtsi"

/ {
	model = "Qualcomm Technologies, Inc. SDXLEMUR M2 EP FWA V2";
	compatible = "qcom,sdxlemur-mtp",
		"qcom,sdxlemur", "qcom,mtp";
	qcom,board-id = <0x11010008 0x311>;
};

&sdx_ext_ipc {
	qcom,status-in-gpio = <&tlmm 12 0x00>;
	qcom,status-out-gpio = <&tlmm 13 0x00>;
	qcom,status-out2-gpio = <&tlmm 15 0x00>;
	status = "ok";
};
