#include "sdxlemur-cnss.dtsi"

&pcie0 {
	qcom,boot-option = <0x1>;
};

&pcie0_bus2_dev2_fn0 {
	cnss_pci0: cnss_pci0 {
		reg = <0 0 0 0 0>;
		qcom,iommu-group = <&cnss_pci_iommu_group>;
		memory-region = <&cnss_wlan_mem>;

		#address-cells = <1>;
		#size-cells = <1>;
	};
};
