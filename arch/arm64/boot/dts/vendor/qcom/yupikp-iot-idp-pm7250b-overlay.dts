/dts-v1/;
/plugin/;

#include "yupikp-iot-idp-pm7250b.dtsi"

/ {
	model = "Qualcomm Technologies, Inc. YupikP IOT IDP + PM7250B";
	compatible = "qcom,yupikp-iot-idp", "qcom,yupikp-iot", "qcom,idp";
	qcom,msm-id = <498 0x10000>;
	qcom,board-id = <34 0>;
};
