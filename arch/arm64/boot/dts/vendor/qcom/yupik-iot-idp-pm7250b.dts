/dts-v1/;

#include "yupik-iot.dtsi"
#include "yupik-iot-idp-pm7250b.dtsi"

/ {
	model = "Qualcomm Technologies, Inc. Yupik IOT IDP + PM7250B";
	compatible = "qcom,yupik-iot-idp", "qcom,yupik-iot", "qcom,idp";
	qcom,board-id = <34 0>;
};
