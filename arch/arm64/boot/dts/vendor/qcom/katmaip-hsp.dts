/dts-v1/;

#include "katmaip.dtsi"
#include "yupikp-iot-hsp.dtsi"

/ {
	model = "Qualcomm Technologies, Inc. KatmaiP HSP";
	compatible = "qcom,yupikp-iot-idp", "qcom,yupikp-iot", "qcom,idp";
	qcom,board-id = <34 1>;
};
